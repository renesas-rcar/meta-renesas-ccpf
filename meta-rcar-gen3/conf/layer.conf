## meta-rcar-gen3/conf/layer.conf
```bitbake
# We have a conf and classes directory, add to BBPATH
BBPATH .= ":${LAYERDIR}"

# We have recipes-* directories, add to BBFILES
BBFILES += "${LAYERDIR}/recipes-*/*/*.bb \
            ${LAYERDIR}/recipes-*/*/*.bbappend"

BBFILE_COLLECTIONS += "meta-rcar-gen3-ccpf"
BBFILE_PATTERN_meta-rcar-gen3-ccpf = "^${LAYERDIR}/"
BBFILE_PRIORITY_meta-rcar-gen3-ccpf = "6"

LAYERDEPENDS_meta-rcar-gen3-ccpf = "rcar-gen3"
LAYERSERIES_COMPAT_meta-rcar-gen3-ccpf = "dunfell kirkstone"
```
